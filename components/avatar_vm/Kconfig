## components/avatar_vm/Kconfig
```kconfig
menu "Avatar (face VM)"

config AVATAR_DEFAULT_FACE
    string "Default face DSL (file name under assets/)"
    default "default_face.avdsl"
    help
        firmware に埋め込むデフォルト顔の .avdsl (assets/ 直下のファイル名)。
        ビルド時に tools/avatar_dsl/cli.mjs でコンパイルされ、NVS に顔が
        無いときと POST /api/avatar-dsl/reset のときに使われる。
        候補: default_face.avdsl (スタックチャン標準) / omega_mouth.avdsl /
        aokko_face.avdsl / purin_face.avdsl (「プリンを守る技術」の顔、シアン背景)。

endmenu
```

## components/jtts/Kconfig
```kconfig
menu "jtts (Japanese TTS)"

config JTTS_ENABLE_HMM
    bool "Enable HMM (hts_engine) synthesis engine"
    default n
    help
        HMM 音声合成 (hts_engine) を有効にする。.htsvoice ボイス (~1-2 MB) を
        flash の voice パーティションに置ける 16 MB flash + PSRAM ボード
        (CoreS3 / stopwatch) 向け。無効時は render_hmm がスタブになり
        hts_engine のコードはリンクされない。

config JTTS_ENABLE_SANO
    bool "Enable sanoTTS-jp (neural, 559K params) synthesis engine"
    default n
    help
        sanoTTS-jp (蒸留ニューラル TTS、22.05 kHz) を jtts::Engine::Sano として
        有効にする。重み blob (654 KB、sanoTTS-jp Model License 1.0) は
        `sano` パーティション (partitions_16mb.csv) に焼いて mmap する。
        合成の作業領域 176 KB は既定で PSRAM (JTTS_SANO_ARENA_INTERNAL 参照)。
        無効時は render_sano がスタブになり推論コアはリンクされない。

config JTTS_SANO_KANJI
    bool "sanoTTS: on-device kanji G2P (Open JTalk + 13.7 MB dictionary partition)"
    default n
    depends on JTTS_ENABLE_SANO
    help
        漢字かな交じり文をそのまま読めるようにする (sanoTTS-jp 上流の端末内 G2P:
        辞書 k1-dict-438750.bin を `dict` パーティションに焼いて mmap し、Open JTalk の
        NJD 鎖で読みとアクセントを付ける)。flash に 13.7 MB 要るので、OTA 無しの
        単一アプリ構成 (BOARD=cores3-dict、partitions_16mb_dict.csv) 専用。
        1 文あたり Open JTalk が PSRAM を最大 ~105 KB 使う。辞書は枝刈りしてあるので
        フル辞書と読みが変わる文がある (上流実測 17.79%、地名・固有名詞)。

config JTTS_SANO_SPEED_PCT
    int "sanoTTS: duration scale correction [%] (100 = model default, larger = slower)"
    default 125
    range 50 200
    depends on JTTS_ENABLE_SANO
    help
        sanoTTS-jp の学習モデルはそのままだと話速が速めなので、音素の継続長
        (duration scale s_v) に掛ける補正。125 なら継続長 1.25 倍 = 約 20% ゆっくり。
        ピッチは変わらない。jtts 設定の mora_ms (既定 110 = 等速) はこの上に相対で効く。
        上流 (SanoTTS-jp-M5StackCoreS3) との checksum 突き合わせは 100 + mora_ms 110 で行う。

config JTTS_SANO_ARENA_INTERNAL
    bool "sanoTTS: try internal DRAM for the 176 KB synthesis arena"
    default n
    depends on JTTS_ENABLE_SANO
    help
        合成の作業領域 (176 KB) をまず内部 DRAM から取る (取れなければ PSRAM)。
        内部 DRAM だと上流実測で xRT 0.45 (PSRAM は未計測、数倍遅い見込み)。
        このファームは WiFi / BLE / esp-sr と内部 RAM を奪い合うので既定は OFF
        (常に PSRAM)。発話は全部合成してから鳴らすので、遅い分は待ち時間になるだけ。

endmenu
```
